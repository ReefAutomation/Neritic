## sdkconfig.defaults.2mb
```kconfig
CONFIG_HTTPD_WS_SUPPORT=y
CONFIG_ESPTOOLPY_FLASHSIZE_2MB=y
CONFIG_ESPTOOLPY_FLASHSIZE="2MB"
CONFIG_PARTITION_TABLE_OFFSET=0x9000
CONFIG_PARTITION_TABLE_CUSTOM=y
CONFIG_PARTITION_TABLE_CUSTOM_FILENAME="partitions_2mb.csv"
```

## sdkconfig.defaults.4mb
```kconfig
CONFIG_HTTPD_WS_SUPPORT=y
CONFIG_ESPTOOLPY_FLASHSIZE_4MB=y
CONFIG_ESPTOOLPY_FLASHSIZE="4MB"
CONFIG_HAP_HTTP_SERVER_PORT=12080
CONFIG_HAP_HTTP_CONTROL_PORT=12081
CONFIG_HAP_HTTP_MAX_OPEN_SOCKETS=2
CONFIG_LWIP_MAX_SOCKETS=24
CONFIG_HAP_HTTP_STACK_SIZE=6144
CONFIG_MDNS_NETWORKING_SOCKET=y
```

## sdkconfig.defaults.4mb.debug
```kconfig
CONFIG_HTTPD_WS_SUPPORT=y
CONFIG_ESPTOOLPY_FLASHSIZE_4MB=y
CONFIG_ESPTOOLPY_FLASHSIZE="4MB"
CONFIG_PARTITION_TABLE_CUSTOM=y
CONFIG_PARTITION_TABLE_CUSTOM_FILENAME="partitions.csv"
CONFIG_LWIP_MAX_SOCKETS=16
CONFIG_ESP_SYSTEM_PANIC_PRINT_REBOOT=y
CONFIG_ESP_INT_WDT_TIMEOUT_MS=300
CONFIG_ESP_TASK_WDT_TIMEOUT_S=5
CONFIG_ESP_MAIN_TASK_STACK_SIZE=3584
```

## sdkconfig.defaults.8mb
```kconfig
CONFIG_HTTPD_WS_SUPPORT=y
CONFIG_ESPTOOLPY_FLASHSIZE_8MB=y
CONFIG_ESPTOOLPY_FLASHSIZE="8MB"
```

## sdkconfig.defaults.homekit
```kconfig
CONFIG_HAP_HTTP_SERVER_PORT=12080
CONFIG_HAP_HTTP_CONTROL_PORT=12081
CONFIG_HAP_HTTP_MAX_OPEN_SOCKETS=2
CONFIG_LWIP_MAX_SOCKETS=24
CONFIG_HAP_HTTP_STACK_SIZE=6144
CONFIG_MDNS_NETWORKING_SOCKET=y
```
